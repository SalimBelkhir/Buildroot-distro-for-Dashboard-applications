## client-sensor/client_sensor/main/Kconfig.projbuild
```kconfig
menu "Example Configuration"

    choice EXAMPLE_IP_MODE
        prompt "IP Version"
        help
            Example can use either IPV4 or IPV6.
        config EXAMPLE_IPV4
            bool "IPV4"
        config EXAMPLE_IPV6
            bool "IPV6"
    endchoice

    config EXAMPLE_IPV4_ADDR
        string "IPV4 Address (Pi IP)"
        default "192.168.45.239"
        depends on EXAMPLE_IPV4
        help
            The Pi Gateway IP address.

    config EXAMPLE_IPV6_ADDR
        string "IPV6 Address"
        default "FE80::30AD:E57B:C212:68AD"
        depends on EXAMPLE_IPV6
        help
            The example will connect to this IPV6 address.

    config EXAMPLE_PORT
        int "Port"
        range 0 65535
        default 8080
        help
            The port on which Pi Gateway is listening (should be 8080).

endmenu
```
